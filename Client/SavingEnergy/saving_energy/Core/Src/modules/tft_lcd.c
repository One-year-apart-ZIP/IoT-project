/*
 * tft_lcd.c
 *
 *  Created on: Mar 9, 2024
 *      Author: hojoon
 */

#include "modules/tft_lcd.h"
#include "common/helper.h"

unsigned char Xcharacter, Ycharacter;
unsigned char Xcursor, Ycursor;
unsigned char XcharacterLimit = 40;
unsigned char YcharacterLimit = 30;
unsigned short foreground_color;
unsigned short background_color;

const unsigned char E_font_large[128][36] = {
    {0x00, 0x00, 0x00, 0x00, 0x00, 0x00, 0x00, 0x00, 0x00,
     0x00, 0x00, 0x00, 0x00, 0x00, 0x00, 0x00, 0x00, 0x00, // 0x00
     0x00, 0x00, 0x00, 0x00, 0x00, 0x00, 0x00, 0x00, 0x00,
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     0x00, 0x00, 0x00, 0x00, 0x00, 0x00, 0x00, 0x00, 0x00}};

void TFT_LCD_Init(void) {
  RCC->AHB1ENR |= 0x00000018;
  GPIOC->ODR = 0x00000000;
  GPIOC->OSPEEDR = 0x00550000;

  GPIOD->ODR = 0x00000000;
  GPIOD->OSPEEDR = 0x55005555;

  GPIOE->MODER &= 0xFFFFF00F;
  GPIOE->MODER |= 0x00000550;
  GPIOE->ODR |= 0x00000034;
  GPIOE->OSPEEDR &= 0xFFFF00F;
  GPIOE->OSPEEDR |= 0x00000550;

  GPIOE->BSRR = 0x00200000;
  Delay_ms(1);
  GPIOE->BSRR = 0x00000020;
  Delay_ms(120);

  TFT_LCD_Write(0x02, 0x0000); // window setting
  TFT_LCD_Write(0x03, 0x0000); // x = 0~319
  TFT_LCD_Write(0x04, 0x0001);
  TFT_LCD_Write(0x05, 0x003F);
  TFT_LCD_Write(0x06, 0x0000); // y = 0~239
  TFT_LCD_Write(0x07, 0x0000);
  TFT_LCD_Write(0x08, 0x0000);
  TFT_LCD_Write(0x09, 0x00EF);

  TFT_LCD_Write(0x01, 0x0006); // display setting
  TFT_LCD_Write(0x16, 0x0068); // MV=1, MX=1, MY=0, BGR=1
  TFT_LCD_Write(0x18, 0x0000); // SM=0
  TFT_LCD_Write(0x70, 0x0065); // GS=1, SS=1, 16 bit/pixel
  TFT_LCD_Write(0x23, 0x0095);
  TFT_LCD_Write(0x24, 0x0095);
  TFT_LCD_Write(0x25, 0x00FF);
  TFT_LCD_Write(0x27, 0x0002);
  TFT_LCD_Write(0x28, 0x0002);
  TFT_LCD_Write(0x29, 0x0002);
  TFT_LCD_Write(0x2A, 0x0002);
  TFT_LCD_Write(0x2C, 0x0002);
  TFT_LCD_Write(0x2D, 0x0002);
  TFT_LCD_Write(0x3A, 0x0001);
  TFT_LCD_Write(0x3B, 0x0001);
  TFT_LCD_Write(0x3C, 0x00F0);
  TFT_LCD_Write(0x3D, 0x0000);
  Delay_ms(20);
  TFT_LCD_Write(0x35, 0x0038);
  TFT_LCD_Write(0x36, 0x0078);
  TFT_LCD_Write(0x3E, 0x0038);
  TFT_LCD_Write(0x40, 0x000F);
  TFT_LCD_Write(0x41, 0x00F0);

  TFT_LCD_Write(0x19, 0x0049); // power setting
  TFT_LCD_Write(0x93, 0x000F);
  Delay_ms(10);
  TFT_LCD_Write(0x20, 0x0040);
  TFT_LCD_Write(0x1D, 0x0007);
  Delay_ms(10);
  TFT_LCD_Write(0x1E, 0x0000);
  TFT_LCD_Write(0x1F, 0x0004);
  TFT_LCD_Write(0x44, 0x0040); // VCom control for 3.3V
  TFT_LCD_Write(0x45, 0x0012);
  Delay_ms(10);
  TFT_LCD_Write(0x1C, 0x0004);
  Delay_ms(20);
  TFT_LCD_Write(0x43, 0x0080);
  Delay_ms(5);
  TFT_LCD_Write(0x1B, 0x0018);
  Delay_ms(40);
  TFT_LCD_Write(0x1B, 0x0010);
  Delay_ms(40);

  TFT_LCD_Write(0x46, 0x00A4); // gamma setting
  TFT_LCD_Write(0x47, 0x0053);
  TFT_LCD_Write(0x48, 0x0010);
  TFT_LCD_Write(0x49, 0x005F);
  TFT_LCD_Write(0x4A, 0x0004);
  TFT_LCD_Write(0x4B, 0x003F);
  TFT_LCD_Write(0x4C, 0x0002);
  TFT_LCD_Write(0x4D, 0x00F6);
  TFT_LCD_Write(0x4E, 0x0012);
  TFT_LCD_Write(0x4F, 0x004C);
  TFT_LCD_Write(0x50, 0x0046);
  TFT_LCD_Write(0x51, 0x0044);

  TFT_LCD_Write(0x90, 0x007F); // display on setting
  TFT_LCD_Write(0x26, 0x0004);
  Delay_ms(40);
  TFT_LCD_Write(0x26, 0x0024);
  TFT_LCD_Write(0x26, 0x002C);
  Delay_ms(40);
  TFT_LCD_Write(0x26, 0x003C);

  TFT_LCD_Write(0x57, 0x0002); // internal VDDD setting
  TFT_LCD_Write(0x55, 0x0000);
  TFT_LCD_Write(0xFE, 0x005A);
  TFT_LCD_Write(0x57, 0x0000);
}

void TFT_LCD_Command(unsigned short IR) {
  // CS, RS = 0
  GPIOE->BSRR = 0x00180000;
  GPIOD->ODR = IR;
  GPIOC->ODR = IR;
  GPIOE->BSRR = 0x00040000;

  __NOP();
  __NOP();
  __NOP();
  __NOP();
  __NOP();
  __NOP();
  __NOP();

  GPIOE->BSRR = 0x00000004; // SET WR
  __NOP();
  GPIOE->BSRR = 0x00000008; // SET CS
}

void TFT_LCD_Data(unsigned short DR) {
  // CS = 0, RS = 1
  GPIOE->BSRR = 0x00100008;
  GPIOD->ODR = DR;
  GPIOC->ODR = DR;
  GPIOE->BSRR = 0x00040000; // RESET WR

  __NOP();
  __NOP();
  __NOP();
  __NOP();
  __NOP();
  __NOP();
  __NOP();

  GPIOE->BSRR = 0x00000004; // SET WR
  __NOP();
  GPIOE->BSRR = 0x00000008; // SET CS
}

void TFT_LCD_Write(unsigned short reg, unsigned short value) {
  TFT_LCD_Command(reg);
  TFT_LCD_Data(value);
}

void TFT_LCD_Color_screen(unsigned short start_x, unsigned short start_y,
                          unsigned short width, unsigned short height,
                          unsigned short color) {
  unsigned short i, j;

  TFT_LCD_GRAM_Set(start_x, start_y);

  for (i = 0; i < width; ++i) {
    for (j = 0; j < height; ++j) {
      TFT_LCD_Data(color);
    }
  }
}

void TFT_LCD_GRAM_Set(unsigned short x, unsigned short y) {
  // Screen Mode = Landscape
  if (x > 319 || y > 239)
    return;
  TFT_LCD_Write(0x02, x >> 8);
  TFT_LCD_Write(0x03, x & 0x00FF);
  TFT_LCD_Write(0x06, 0x0000);
  TFT_LCD_Write(0x07, y);

  TFT_LCD_Command(0x22);
}

void TFT_LCD_xy(unsigned char x, unsigned char y) {
  Xcharacter = x;
  Ycharacter = y;
}

void TFT_LCD_Color(unsigned short foreground, unsigned short background) {
  foreground_color = foreground;
  background_color = background;
}

void TFT_LCD_Write_Pixel(unsigned short x, unsigned short y,
                         unsigned short color) {
  // Landscape
  if (x > 319 || y > 239)
    return;

  TFT_LCD_Write(0x02, x >> 8);
  TFT_LCD_Write(0x03, x & 0x00FF);
  TFT_LCD_Write(0x06, 0x0000);
  TFT_LCD_Write(0x07, y);

  TFT_LCD_Write(0x22, color);
}

void TFT_LCD_Landscape(void) {
  TFT_LCD_Write(0x16, 0x0068); // MV=1, MX=1, MY=0, BGR=1

  TFT_LCD_Write(0x02, 0x0000); // x = 0~319
  TFT_LCD_Write(0x03, 0x0000);
  TFT_LCD_Write(0x04, 0x0001);
  TFT_LCD_Write(0x05, 0x003F);
  TFT_LCD_Write(0x06, 0x0000); // y = 0~239
  TFT_LCD_Write(0x07, 0x0000);
  TFT_LCD_Write(0x08, 0x0000);
  TFT_LCD_Write(0x09, 0x00EF);

  XcharacterLimit = 26; // 40x30 character unit
  YcharacterLimit = 30;
}

void TFT_LCD_String(unsigned char x, unsigned char y, unsigned short foreground,
                    unsigned short background, char *str) {
  unsigned char ch1;

  Xcharacter = x;
  Ycharacter = y;

  foreground_color = foreground;
  background_color = background;

  while (*str) {
    ch1 = *str;
    str++;
    TFT_LCD_English(ch1);
  }
}

void TFT_LCD_English(unsigned char code) {
  unsigned char data, x, y;
  unsigned short pixel[12][24];

  for (x = 0; x < 12; x++) // read English ASCII font
  {
    data = E_font_large[code][x];
    for (y = 0; y < 8; y++) {
      if (data & 0x01)
        pixel[x][y] = foreground_color;
      else
        pixel[x][y] = background_color;
      data = data >> 1;
    }
  }

  for (x = 0; x < 12; x++) {
    data = E_font_large[code][x + 12];
    for (y = 0; y < 8; y++) {
      if (data & 0x01)
        pixel[x][y + 8] = foreground_color;
      else
        pixel[x][y + 8] = background_color;
      data = data >> 1;
    }
  }

  for (x = 0; x < 12; x++) {
    data = E_font_large[code][x + 24];
    for (y = 0; y < 8; y++) {
      if (data & 0x01)
        pixel[x][y + 16] = foreground_color;
      else
        pixel[x][y + 16] = background_color;
      data = data >> 1;
    }
  }

  if (Xcharacter >= XcharacterLimit) // end of line ?
  {
    Xcharacter = 0;
    Ycharacter += 3;
    if (Ycharacter >= (YcharacterLimit - 2)) // end of screen ?
      Ycharacter = 0;
  }

  for (y = 0; y < 24; y++) // if yes, write a character
    for (x = 0; x < 12; x++)
      TFT_LCD_Write_Pixel(Xcharacter * 12 + x, Ycharacter * 8 + y, pixel[x][y]);

  Xcharacter += 1; // go to next position
}

void TFT_LCD_Unsigned_Decimal(unsigned int number, unsigned char zerofill,
                              unsigned char digit) {
  unsigned char zero_flag, character;
  unsigned int div;

  if ((digit == 0) || (digit > 9))
    return;

  div = 1;

  while (--digit)
    div *= 10;

  zero_flag = zerofill;

  while (div > 0) {
    character = number / div;
    if ((character == 0) && (zero_flag == 0) && (div != 1))
      TFT_LCD_English(character + ' ');
    else {
      zero_flag = 1;
      TFT_LCD_English(character + '0');
    }
    number %= div;
    div /= 10;
  }
}

void TFT_LCD_Signed_Decimal(int number, unsigned char zerofill,
                            unsigned char digit) {
  unsigned char zero_flag, character;
  unsigned int div;

  if ((digit == 0) || (digit > 9))
    return;

  if (number >= 0) // display sign
    TFT_LCD_English('+');
  else {
    TFT_LCD_English('-');
    number = -number;
  }

  div = 1;
  while (--digit)
    div *= 10;

  zero_flag = zerofill;
  while (div > 0) // display number
  {
    character = number / div;
    if ((character == 0) && (zero_flag == 0) && (div != 1))
      TFT_LCD_English(character + ' ');
    else {
      zero_flag = 1;
      TFT_LCD_English(character + '0');
    }
    number %= div;
    div /= 10;
  }
}

void TFT_LCD_Signed_Float(float number, unsigned char integral,
                          unsigned char fractional) {
  unsigned char zero_flag, digit, character;
  unsigned int div, integer;

  digit = integral + fractional;
  if ((integral == 0) || (fractional == 0) || (digit > 9))
    return;

  // Display sign
  if (number >= 0)
    TFT_LCD_English('+');
  else {
    TFT_LCD_English('-');
    number = -number;
  }

  div = 1;

  while (--digit)
    div *= 10;

  while (fractional--)
    number *= 10.;
  integer = (unsigned int)(number + 0.5);

  zero_flag = 0;
  digit = 1;

  while (div > 0) {
    character = integer / div;
    if ((character == 0) && (zero_flag == 0) && (digit != integral))
      TFT_LCD_English(character + ' ');
    else {
      zero_flag = 1;
      TFT_LCD_English(character + '0');
    }
    integer %= div;
    div /= 10;
    if (digit == integral)
      TFT_LCD_English('.');
    digit++;
  }
}
